/*
 * ESP32 SSD1306 128x32 OLED using the modern U8g2 library
 *
 * Description: This is the recommended way to display a bitmap on an ESP32.
 *              It uses the U8g2 library, which is the successor to U8glib.

 */

// Core Arduino and the modern U8g2 library
#include <Arduino.h>
#include <U8g2lib.h>
#include <Wire.h>

// --- Pin Definitions ---
#define SDA 22
#define SCL 23

#define BUTTON1 18  // Left
#define BUTTON2 19  // Right
#define BUTTON3 21  // Select / Back (Hold)

// --- U8g2 Display Object Instantiation ---
// This is the correct constructor for an SSD1306 128x32 display using
// hardware I2C on the ESP32.
// U8G2_R0: No rotation
// U8X8_PIN_NONE: No reset pin is being used
// SCL, SDA: Your I2C pins
U8G2_SSD1306_128X32_UNIVISION_F_HW_I2C u8g2(U8G2_R0, /* reset=*/ U8X8_PIN_NONE, /* clock=*/ SCL, /* data=*/ SDA);


// --- BITMAP DATA (This format is compatible with U8g2) ---

// --- UI Elements ---
// 'item_outline', 128x32px
const unsigned char epd_bitmap_item_outline [] PROGMEM = {
	0x00, 0x00, 0x00, 0x00, 0x00, 0x00, 0x00, 0x00, 0x00, 0x00, 0x00, 0x00, 0x00, 0x00, 0x00, 0x00, 
	0x00, 0x00, 0x00, 0x00, 0x00, 0x00, 0x00, 0x00, 0x00, 0x00, 0x00, 0x00, 0x00, 0x00, 0x00, 0x00, 
	0x00, 0x00, 0x00, 0x00, 0x00, 0x00, 0x00, 0x00, 0x00, 0x00, 0x00, 0x00, 0x00, 0x00, 0x00, 0x00, 
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	0x00, 0x00, 0x00, 0x00, 0x00, 0x00, 0x00, 0x00, 0x00, 0x00, 0x00, 0x00, 0x00, 0x00, 0x00, 0x00
};
// 'scroll_bar', 16x8px
const unsigned char epd_bitmap_scroll_bar [] PROGMEM = {
	0x00, 0xff, 0x40, 0xff, 0x00, 0xff, 0x40, 0xff, 0x00, 0xff, 0x40, 0xff, 0x00, 0xff, 0x40, 0xff
};
// 'scroll_bar_knob', 16x8px
const unsigned char epd_bitmap_scroll_bar_knob [] PROGMEM = {
	0x00, 0xff, 0xe0, 0xff, 0xe0, 0xff, 0xe0, 0xff, 0xe0, 0xff, 0xe0, 0xff, 0x00, 0xff, 0x00, 0xff
};
// 'hierarchy_marker', 16x8px
const unsigned char epd_bitmap_hierarchy_marker [] PROGMEM = {
	0x0f, 0xff, 0x0f, 0xff, 0x00, 0xff, 0x00, 0xff, 0x80, 0xff, 0x00, 0xff, 0x02, 0xff, 0x80, 0xff
};

// --- Icons ---
// 'track_shot_icon', 16x8px
const unsigned char epd_bitmap_track_shot_icon [] PROGMEM = {
	0x00, 0x00, 0x80, 0x01, 0x80, 0x01, 0x18, 0x18, 0x18, 0x18, 0x00, 0x00, 0x06, 0x60, 0x06, 0x60
};
// 'battery_icon', 16x8px
const unsigned char epd_bitmap_battery_icon [] PROGMEM = {
	0x00, 0x00, 0xc0, 0x03, 0xc0, 0x03, 0xf0, 0x0f, 0x10, 0x08, 0xd0, 0x0b, 0xd0, 0x0b, 0x10, 0x08
};
// 'gps_icon', 16x8px
const unsigned char epd_bitmap_gps_icon [] PROGMEM = {
	0x38, 0x00, 0x04, 0x00, 0x32, 0x00, 0x09, 0x30, 0x25, 0x48, 0x15, 0x84, 0x80, 0x83, 0xc0, 0x43
};
// 'location_icon', 16x8px
const unsigned char epd_bitmap_location_icon [] PROGMEM = {
	0xc0, 0x07, 0x60, 0x0c, 0xb0, 0x1b, 0xd0, 0x17, 0xd0, 0x17, 0xd0, 0x17, 0xf0, 0x1f, 0xe0, 0x0f
};
// 'folder_icon', 16x8px
const unsigned char epd_bitmap_folder_icon [] PROGMEM = {
	0x00, 0x00, 0x3f, 0x00, 0xe1, 0x3f, 0x01, 0x20, 0x01, 0x20, 0x01, 0xff, 0x81, 0x80, 0x7d, 0x80
};
// 'settings_icon', 16x8px
const unsigned char epd_bitmap_settings_icon [] PROGMEM = {
	0x00, 0x00, 0x00, 0x00, 0x80, 0x01, 0x90, 0x09, 0xb8, 0x1d, 0xf0, 0x0f, 0x60, 0x06, 0x3c, 0x3c
};
// 'placeholder_icon', 16x8px
const unsigned char epd_bitmap_placeholder_icon [] PROGMEM = {
	0x00, 0x00, 0x00, 0x00, 0xf0, 0x07, 0xf0, 0x0f, 0x30, 0x0c, 0x30, 0x0c, 0x30, 0x0c, 0xf0, 0x0f
};

// --- Arrows ---
// 'up_arrow', 16x8px
const unsigned char epd_bitmap_up_arrow [] PROGMEM = {
	0x00, 0x00, 0x80, 0x01, 0xe0, 0x07, 0xf8, 0x1f, 0x00, 0x00, 0x00, 0x00, 0x00, 0x00, 0x00, 0x00
};
// 'down_arrow', 16x8px
const unsigned char epd_bitmap_down_arrow [] PROGMEM = {
	0x00, 0x00, 0x00, 0x00, 0x00, 0x00, 0x00, 0x00, 0xf8, 0x1f, 0xe0, 0x07, 0x80, 0x01, 0x00, 0x00
};

// Array of all bitmaps for convenience
const int epd_bitmap_allArray_LEN = 13;
const unsigned char* epd_bitmap_allArray[epd_bitmap_allArray_LEN] = {
	// UI Elements [0-3]
	epd_bitmap_item_outline,        // 0
	epd_bitmap_scroll_bar,          // 1
	epd_bitmap_scroll_bar_knob,     // 2
  epd_bitmap_hierarchy_marker,    // 3
	// Icons [4-10]
	epd_bitmap_track_shot_icon,     // 4
	epd_bitmap_battery_icon,        // 5 
	epd_bitmap_gps_icon,            // 6
	epd_bitmap_location_icon,       // 7 
	epd_bitmap_folder_icon,         // 8
	epd_bitmap_settings_icon,       // 9
	epd_bitmap_placeholder_icon,    // 10
	// Arrows [11-12]
	epd_bitmap_up_arrow,            // 11
	epd_bitmap_down_arrow           // 12
};

// Variable to store the Y position of the scrollbar knob
int knobY = 0;

void setup(void) {
  pinMode(BUTTON1, INPUT_PULLUP);
  pinMode(BUTTON2, INPUT_PULLUP);
  pinMode(BUTTON3, INPUT_PULLUP);
  u8g2.begin();
}

void loop(void) {
  // --- Check for Button Presses ---
  // If button 1 is pressed (LOW since it's INPUT_PULLUP), move knob down
  if (digitalRead(BUTTON1) == LOW) {
    knobY++;
  }
  // If button 2 is pressed, move knob up
  if (digitalRead(BUTTON2) == LOW) {
    knobY--;
  }

  // --- Constrain Knob Position ---
  // Ensure knobY doesn't go above the top limit (0)
  if (knobY < 0) {
    knobY = 0;
  }
  // Ensure knobY doesn't go below the bottom limit (24)
  if (knobY > 24) {
    knobY = 24;
  }

  // --- Redraw the entire screen ---
  u8g2.clearBuffer();
  u8g2.setBitmapMode(1); // Set transparent mode for overlapping bitmaps

  // Draw all the static background elements
  u8g2.drawXBM(0, 0, 128, 32, epd_bitmap_allArray[0]); // item_outline
  
  // Conditionally draw the Up arrow (hide if knob is at the top)
  if (knobY > 0) {
    u8g2.drawXBM(54, 0, 16, 8, epd_bitmap_allArray[11]); // up_arrow
  }
  
  // Conditionally draw the Down arrow (hide if knob is at the bottom)
  if (knobY < 24) {
    u8g2.drawXBM(54, 24, 16, 8, epd_bitmap_allArray[12]); // down_arrow
  }
  
  u8g2.drawXBM(120, 0, 8, 32, epd_bitmap_allArray[1]); // scroll_bar
  u8g2.drawXBM(4, 8, 16, 16, epd_bitmap_allArray[4]); // track_shot_icon

  // Draw the knob at its current 'knobY' position
  u8g2.drawXBM(120, knobY, 8, 8, epd_bitmap_allArray[2]); // scroll_bar_knob

  // Draw the text
  u8g2.setFont(u8g2_font_7x14B_tf);
  u8g2.drawStr(23, 20, "Track Shot");

  // Send the completed drawing to the display
  u8g2.sendBuffer();

  // Add a small delay for debouncing, so one press doesn't register many times
  delay(50);
}